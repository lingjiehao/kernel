## drivers/learn/Kconfig
```kconfig
menu "Learn driver"

source "drivers/learn/platform/Kconfig"

source "drivers/learn/i2c/Kconfig"

endmenu
```

## drivers/learn/i2c/Kconfig
```kconfig
config LEARN_I2C
bool "Build i2c driver"
default n

if LEARN_I2C
	config EEPROM_AT24C256
		tristate "EEPROM AT24C256 driver"
		default n

endif
```

## drivers/learn/platform/Kconfig
```kconfig
config LEARN_PLATFORM
bool "Build platform driver"
default n

if LEARN_PLATFORM

	config SIMPLE_PLATFORM
		tristate "Simple platform driver"
		default n
		help
			My first platform driver

endif
```
