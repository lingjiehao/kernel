/dts-v1/;
/plugin/;

&i2c1 {
	#address-cells = <1>;
	#size-cells = <0>;

	at24c256: at24c256@50 {
		compatiable = "atmel,at24c256";
		reg = <0x50>; /* Slave address: 0x50 */
		size = <32768>; /* 256 * 1024 / 8 = 32768 byte */
		status = "ok";
	};
};
